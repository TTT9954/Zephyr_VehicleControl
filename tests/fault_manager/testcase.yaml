## tests/fault_manager/testcase.yaml
```yaml
tests:
  vehicle_control.fault_manager:
    platform_allow:
      - native_sim
    tags:
      - vehicle
      - unit
```

## tests/vehicle_control/testcase.yaml
```yaml
tests:
  vehicle_control.logic:
    platform_allow:
      - native_sim
    tags:
      - vehicle
      - unit
```
