## CMakeLists.txt
```
cmake_minimum_required(VERSION 3.20.0)
find_package(Zephyr REQUIRED HINTS $ENV{ZEPHYR_BASE})
project(zephyr_vehicle_control)
target_include_directories(app PRIVATE include)
target_sources(app PRIVATE
 src/main.c src/app/vehicle_control.c src/app/vehicle_state.c src/app/speed_monitor.c
 src/drivers/adc_sensor.c src/drivers/gpio_control.c src/drivers/can_interface.c
 src/services/sensor_manager.c src/services/can_manager.c src/services/fault_manager.c
 src/utils/ring_buffer.c src/utils/data_filter.c)
```

## Kconfig
```
mainmenu "Vehicle Control Demo"
source "Kconfig.zephyr"
```

## prj.conf
```kconfig
CONFIG_MULTITHREADING=y
CONFIG_LOG=y
CONFIG_LOG_DEFAULT_LEVEL=3
CONFIG_MAIN_STACK_SIZE=2048
CONFIG_THREAD_NAME=y
CONFIG_THREAD_MONITOR=y
# Optional physical peripherals are disabled for native_sim.
# CONFIG_GPIO=y
# CONFIG_ADC=y
# CONFIG_CAN=y
```

## src/main.c
```c
#include <zephyr/kernel.h>
#include <zephyr/logging/log.h>
#include "app_config.h"
#include "app_types.h"
#include "sensor_manager.h"
#include "vehicle_control.h"
#include "fault_manager.h"
#include "can_manager.h"
LOG_MODULE_REGISTER(vehicle_main, LOG_LEVEL_INF);
K_SEM_DEFINE(start_sem, 0, 3);
static void sensor_thread(void *a, void *b, void *c)
{
    (void)a; (void)b; (void)c;
    k_sem_take(&start_sem, K_FOREVER);
    while (1) { sensor_manager_poll(); k_msleep(SENSOR_PERIOD_MS); }
}
static void control_thread(void *a, void *b, void *c)
{
    (void)a; (void)b; (void)c;
    k_sem_take(&start_sem, K_FOREVER);
    vehicle_status_t status = {.state = VEH_OFF};
    while (1) {
        sensor_sample_t sample = {0};
        if (sensor_manager_get_latest(&sample)) {
            uint32_t age = k_uptime_get_32() - sample.timestamp_ms;
            bool fault = fault_manager_active() || age > SENSOR_TIMEOUT_MS;
            status = vehicle_control_step(status, sample, fault);
            can_manager_publish(status);
        }
        k_msleep(CONTROL_PERIOD_MS);
    }
}
static void fault_thread(void *a, void *b, void *c)
{
    (void)a; (void)b; (void)c;
    k_sem_take(&start_sem, K_FOREVER);
    while (1) {
        sensor_sample_t sample = {0};
        bool valid = sensor_manager_get_latest(&sample);
        uint32_t age = valid ? k_uptime_get_32() - sample.timestamp_ms : UINT32_MAX;
        fault_manager_update(valid, age, sample.speed_kph);
        k_msleep(FAULT_PERIOD_MS);
    }
}
static void can_thread(void *a, void *b, void *c)
{
    (void)a; (void)b; (void)c;
    while (1) can_manager_process();
}
K_THREAD_DEFINE(sensor_tid, 1024, sensor_thread, NULL, NULL, NULL, 5, 0, 0);
K_THREAD_DEFINE(control_tid, 1024, control_thread, NULL, NULL, NULL, 4, 0, 0);
K_THREAD_DEFINE(fault_tid, 1024, fault_thread, NULL, NULL, NULL, 6, 0, 0);
K_THREAD_DEFINE(can_tid, 1024, can_thread, NULL, NULL, NULL, 7, 0, 0);
int main(void)
{
    sensor_manager_init();
    LOG_INF("Zephyr Vehicle Control demo starting");
    k_sem_give(&start_sem); k_sem_give(&start_sem); k_sem_give(&start_sem);
    return 0;
}
```

## include/adc_sensor.h
```c
#ifndef ADC_SENSOR_H
#define ADC_SENSOR_H
#include <stdint.h>
uint16_t adc_sensor_read_speed_kph(void);
#endif
```

## include/app_config.h
```c
#ifndef APP_CONFIG_H
#define APP_CONFIG_H
#define SENSOR_PERIOD_MS 10
#define CONTROL_PERIOD_MS 20
#define FAULT_PERIOD_MS 100
#define CAN_TX_PERIOD_MS 100
#define SENSOR_TIMEOUT_MS 250
#define SPEED_LIMIT_KPH 90U
#define SPEED_HYSTERESIS_KPH 3U
#endif
```

## include/app_types.h
```c
#ifndef APP_TYPES_H
#define APP_TYPES_H
#include <stdbool.h>
#include <stdint.h>
typedef enum { VEH_OFF=0, VEH_PRE_DRIVE, VEH_DRIVE, VEH_POST_DRIVE } vehicle_state_t;
typedef struct { uint16_t speed_kph; bool ready; bool ignition; uint32_t timestamp_ms; } sensor_sample_t;
typedef struct { vehicle_state_t state; bool speed_limited; bool fault_active; uint16_t speed_kph; uint32_t uptime_ms; } vehicle_status_t;
#endif
```

## include/can_interface.h
```c
#ifndef CAN_INTERFACE_H
#define CAN_INTERFACE_H
#include "app_types.h"
void can_interface_send_status(vehicle_status_t status);
#endif
```

## include/can_manager.h
```c
#ifndef CAN_MANAGER_H
#define CAN_MANAGER_H
#include "app_types.h"
void can_manager_publish(vehicle_status_t status);
void can_manager_process(void);
#endif
```

## include/data_filter.h
```c
#ifndef DATA_FILTER_H
#define DATA_FILTER_H
#include <stdint.h>
uint16_t data_filter_iir_u16(uint16_t previous, uint16_t sample);
#endif
```

## include/fault_manager.h
```c
#ifndef FAULT_MANAGER_H
#define FAULT_MANAGER_H
#include <stdbool.h>
#include <stdint.h>
void fault_manager_update(bool have_sample, uint32_t sample_age_ms, uint16_t speed_kph);
bool fault_manager_active(void);
#endif
```

## include/gpio_control.h
```c
#ifndef GPIO_CONTROL_H
#define GPIO_CONTROL_H
#include <stdbool.h>
bool gpio_control_ignition_on(void);
bool gpio_control_vehicle_ready(void);
#endif
```

## include/ring_buffer.h
```c
#ifndef RING_BUFFER_H
#define RING_BUFFER_H
#include <stdbool.h>
#include <stdint.h>
#define RING_CAPACITY 16U
typedef struct { uint16_t items[RING_CAPACITY]; uint8_t head; uint8_t count; } speed_ring_t;
void ring_buffer_push(speed_ring_t *r, uint16_t value);
bool ring_buffer_latest(const speed_ring_t *r, uint16_t *out);
#endif
```

## include/sensor_manager.h
```c
#ifndef SENSOR_MANAGER_H
#define SENSOR_MANAGER_H
#include "app_types.h"
#include <stdbool.h>
void sensor_manager_init(void);
void sensor_manager_poll(void);
bool sensor_manager_get_latest(sensor_sample_t *out);
#endif
```

## include/speed_monitor.h
```c
#ifndef SPEED_MONITOR_H
#define SPEED_MONITOR_H
#include <stdbool.h>
#include <stdint.h>
bool speed_monitor_update(bool was_limited, uint16_t speed_kph, uint16_t limit_kph, uint16_t hysteresis_kph);
#endif
```

## include/vehicle_control.h
```c
#ifndef VEHICLE_CONTROL_H
#define VEHICLE_CONTROL_H
#include "app_types.h"
vehicle_status_t vehicle_control_step(vehicle_status_t previous, sensor_sample_t input, bool fault);
#endif
```
